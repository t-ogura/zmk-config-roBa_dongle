## boards/shields/roBa_dongle/Kconfig.defconfig
```kconfig
if SHIELD_ROBA_DONGLE

config ZMK_KEYBOARD_NAME
    default "roBa_dongle"

# config ZMK_KEYMAP
#     default y  # ← 入力不要なのでコメントアウトまたは削除

endif
```

## config/west.yml
```yaml
manifest:
  remotes:
    - name: zmkfirmware
      url-base: https://github.com/zmkfirmware
    - name: carrefinho
      url-base: https://github.com/carrefinho
    - name: caksoylar
      url-base: https://github.com/caksoylar
    - name: sayu-hub
      url-base: https://github.com/sayu-hub

  projects:
    - name: zmk
      remote: zmkfirmware
      revision: main
      import: app/west.yml

    - name: prospector-zmk-module
      remote: carrefinho
      revision: main
      path: modules/prospector-zmk-module

    # 必要に応じて他のモジュールも
    # - name: zmk-pmw3610-driver
    #   remote: caksoylar
    #   revision: main
    #   path: modules/zmk-pmw3610-driver

  self:
    path: config
```
